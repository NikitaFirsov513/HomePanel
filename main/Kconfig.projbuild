## main/Kconfig.projbuild
```kconfig
menu "Home Panel"
    config HOME_PANEL_OAUTH_CLIENT_ID
        string "Yandex OAuth Client ID"
        default "8786096dac574329a844b79923407ffb"

    config HOME_PANEL_OAUTH_CLIENT_SECRET
        string "Yandex OAuth Client secret (local build only)"
        default ""
        help
            Configure locally in sdkconfig; never commit the secret.
            Device OAuth and refresh exchange require this value. It is embedded
            in the firmware. Enable iot:view and iot:control in your OAuth app.

    config HOME_PANEL_REFRESH_SECONDS
        int "Device list refresh interval (seconds)"
        range 10 3600
        default 60

    config HOME_PANEL_RETRY_SECONDS
        int "Retry delay after a request error (seconds)"
        range 1 300
        default 10

    config HOME_PANEL_LOG_FPS
        bool "Log display FPS every 5 seconds"
        depends on ESP_LVGL_ADAPTER_ENABLE_FPS_STATS
        default n
        help
            Enable for on-device performance measurements while scrolling or
            panning. Low or zero FPS is expected when the screen is idle.
endmenu

menu "Ethernet Configuration"

    config EXAMPLE_USE_INTERNAL_ETHERNET
        bool "Use Internal Ethernet"
        default y

    choice EXAMPLE_ETH_PHY
        prompt "Ethernet PHY Device"
        depends on EXAMPLE_USE_INTERNAL_ETHERNET
        default EXAMPLE_ETH_PHY_IP101

        config EXAMPLE_ETH_PHY_IP101
            bool "IP101/IP101GR"

        config EXAMPLE_ETH_PHY_LAN87XX
            bool "LAN87xx"

        config EXAMPLE_ETH_PHY_RTL8201
            bool "RTL8201"

        config EXAMPLE_ETH_PHY_DP83848
            bool "DP83848"

    endchoice

    config EXAMPLE_ETH_MDC_GPIO
        int "SMI MDC GPIO number"
        depends on EXAMPLE_USE_INTERNAL_ETHERNET
        default 31

    config EXAMPLE_ETH_MDIO_GPIO
        int "SMI MDIO GPIO number"
        depends on EXAMPLE_USE_INTERNAL_ETHERNET
        default 52

    config EXAMPLE_ETH_PHY_ADDR
        int "PHY Address"
        depends on EXAMPLE_USE_INTERNAL_ETHERNET
        range -1 31
        default 1

    config EXAMPLE_ETH_PHY_RST_GPIO
        int "PHY Reset GPIO number"
        depends on EXAMPLE_USE_INTERNAL_ETHERNET
        default 51

    config EXAMPLE_USE_SPI_ETHERNET
        bool "Use SPI Ethernet"
        default n

endmenu
```

## sdkconfig.defaults
```kconfig
CONFIG_IDF_TARGET="esp32p4"
CONFIG_ESPTOOLPY_FLASHSIZE_16MB=y
CONFIG_PARTITION_TABLE_CUSTOM=y
CONFIG_PARTITION_TABLE_CUSTOM_FILENAME="partitions.csv"
CONFIG_MBEDTLS_CERTIFICATE_BUNDLE=y
CONFIG_MBEDTLS_CERTIFICATE_BUNDLE_DEFAULT_FULL=y
# Yandex OAuth sends a GlobalSign R3 cross-signed chain.
CONFIG_MBEDTLS_CERTIFICATE_BUNDLE_CROSS_SIGNED_VERIFY=y
CONFIG_LV_COLOR_DEPTH_16=y
CONFIG_BOOTLOADER_LOG_LEVEL_WARN=y
```
